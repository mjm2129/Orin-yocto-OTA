## In_Host/meta-custom_implement_OTA/meta-custom_implement_OTA/conf/layer.conf
```bitbake
BBPATH .= ":${LAYERDIR}"
BBFILES += "${LAYERDIR}/recipes-*/*/*.bb ${LAYERDIR}/recipes-*/*/*.bbappend"

BBFILE_COLLECTIONS += "mycustom"
BBFILE_PATTERN_mycustom := "^${LAYERDIR}/"
BBFILE_PRIORITY_mycustom = "6"

LAYERSERIES_COMPAT_mycustom = "kirkstone"
LAYERDEPENDS_mycustom = "core"
```
